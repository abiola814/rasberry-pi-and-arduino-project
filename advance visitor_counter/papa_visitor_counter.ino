
#include <LiquidCrystal.h>
LiquidCrystal lcd(12, 9, 5, 4, 3, 2);
#include <PCM.h>
const unsigned char sample[] PROGMEM = {
126, 126, 127, 127, 128, 128, 129, 129, 128, 128, 127, 126,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 127, 
};


void play(){
  startPlayback(sample, sizeof(sample)); 
}

int trigpin = 8;
int echopin = A0;
int trigpin2 = 7;
int echopin2 = A1;
const int bt3=6;
const int buttonPin = 13; 
int buttonstate3 =0;// the number of the pushbutton pin
  
const int buttonPin2 = 10;
// the number of the LED pin
int total =0;
// variables will change:
int buttonState = 0; 
int buttonstate2 = 0;

// ulttrasonic setup 
long disa = 0 ,disb =0;
int flag1 =0 ,flag2=0;
int person = 0;

long microsecondsToCentimeters(long microseconds) {
   return microseconds / 29 / 2;
}
void setup() {
  // put your setup code here, to run once:
 
  // put your setup code here, to run once:
Serial.begin(9600);

lcd.begin(20, 4);
lcd.setCursor(0, 0);
lcd.print("welcome ECE DEPT");
delay(2000);
lcd.setCursor(0, 1);
lcd.print("starting system ");
delay(3000);
lcd.setCursor(0, 2);
lcd.print("50% ready ");
delay(3000);
lcd.setCursor(0, 3);
lcd.print("launching.... ");
delay(2000); // Waiting for a while
lcd.clear(); 
///// SETTING TOTAL NUMBER OF VISITOR//////
 
  // check if the pushbutton is pressed. If it is, the buttonState is HIGH:
    int var =0;
    Serial.println("STARING...");
    lcd.setCursor(0, 0);
lcd.print("counter settings----");
delay(2000);
lcd.setCursor(0, 1);
lcd.print("total number ");
delay(1000);
lcd.setCursor(0, 2);
lcd.print("button to select");
delay(1000);
 // Waiting for a while

    while(var<=2){
      buttonState = digitalRead(buttonPin);
      buttonstate2 = digitalRead(buttonPin2);
          buttonstate3 = digitalRead(bt3);
      
      if (buttonState == HIGH) {
    total= total +1;
    lcd.setCursor(0, 3);
lcd.print(total);
    delay(200);
      Serial.print("adding");
    Serial.println(total);
  } 
     if (buttonstate3 == HIGH) {
    total= total-1;
        lcd.setCursor(0, 3);
lcd.print(total);
    delay(200);
    Serial.println(total);
  }
 
  if (buttonstate2 == HIGH) {
    var= var +2;
        lcd.setCursor(0, 3);
lcd.print("done selcting:"+ total);
    delay(200);
   
  }
 
  }
  lcd.clear(); 
  }





void loop() {
  // put your main code here, to run repeatedly:
  long duration, inches, cm;
   pinMode(trigpin, OUTPUT);
   digitalWrite(trigpin, LOW);
   delayMicroseconds(2);
   digitalWrite(trigpin, HIGH);
   delayMicroseconds(10);
   digitalWrite(trigpin, LOW);
   pinMode(echopin, INPUT);
   duration = pulseIn(echopin, HIGH);
   disa = microsecondsToCentimeters(duration);
   delay(30);
   //utrasonic 2 setup
     long duration2, inches2, cm2;
   pinMode(trigpin2, OUTPUT);
   digitalWrite(trigpin2, LOW);
   delayMicroseconds(2);
   digitalWrite(trigpin2, HIGH);
   delayMicroseconds(10);
   digitalWrite(trigpin2, LOW);
   pinMode(echopin2, INPUT);
   duration2 = pulseIn(echopin2, HIGH);
   disb = microsecondsToCentimeters(duration2);
   delay(30);
  
  //------------------------------------------------
  //================================================
  // SETTING UP COUNTER SYSTEM----------------------
  //==================================================
  if (person == total){
     
lcd.setCursor(0, 3);
lcd.print("total number : ");
lcd.setCursor(13,3); 
lcd.print(total);
    play();
    delay(9000000000);
  }
  if(disa<25 && flag1==0){
    flag1=1;
if(flag2==0){
  
  person = person+1;}
}

if(disb<25 && flag2==0){flag2=1;
if(flag1==0){person = person-1;}
}

if(disa>25 && disb>25 && flag1==1 && flag2==1){
flag1=0, flag2=0;
delay(1000); 
}
lcd.setCursor(0, 0);
lcd.print("visitor counter: ");
lcd.setCursor(16,0); 
lcd.print(person);
lcd.setCursor(0, 2);
lcd.print("total set: ");
lcd.setCursor(17,2); 
lcd.print(total);









}
